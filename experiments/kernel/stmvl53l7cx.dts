/dts-v1/;
/plugin/;

/ {
    compatible = "brcm,bcm2835";

    fragment@0 {
        target = <&i2c1>;

        __overlay__ {
            status = "okay";
            #address-cells = <1>;
            #size-cells = <0>;

            stmvl53l7cx: stmvl53l7cx@29 {
                compatible = "st,stmvl53l7cx";
                reg = <0x29>;
                pwr-gpios = <&gpio 16 0>;                
                irq-gpios = <&gpio 26 2>;
                status = "okay";
            };
        };
    };
};


